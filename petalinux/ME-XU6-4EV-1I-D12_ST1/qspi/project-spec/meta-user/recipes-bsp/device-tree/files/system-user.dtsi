/include/ "system-conf.dtsi"
/ {
	model = "Enclustra ME-XU6-4EV-1I-D12 SOM";
};
#include "zynqmp_enclustra_common.dtsi"
#include "zynqmp_enclustra_mercury_st1.dtsi"
#include "zynqmp_enclustra_mercury_xu6.dtsi"
