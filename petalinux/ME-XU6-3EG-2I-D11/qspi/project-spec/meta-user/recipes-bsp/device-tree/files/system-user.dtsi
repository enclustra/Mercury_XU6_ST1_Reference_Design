/include/ "system-conf.dtsi"
/ {
	model = "Enclustra ME-XU6-3EG-2I-D11 SOM";
};
#include "zynqmp_enclustra_common.dtsi"
#include "zynqmp_enclustra_mercury_xu6.dtsi"
#include "zynqmp_enclustra_mercury_st1.dtsi"
