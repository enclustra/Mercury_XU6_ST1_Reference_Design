/include/ "system-conf.dtsi"
/ {
	model = "Enclustra ME-XU6-2EG-1I-D13E SOM";
};
#include "zynqmp_enclustra_common.dtsi"
#include "zynqmp_enclustra_mercury_xu6.dtsi"
#include "zynqmp_enclustra_mercury_st1.dtsi"
