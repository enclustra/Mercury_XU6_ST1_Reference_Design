/include/ "system-conf.dtsi"
/ {
	model = "Enclustra ME-XU6-2CG-1E-D10H SOM";
};
#include "zynqmp_enclustra_common.dtsi"
#include "zynqmp_enclustra_mercury_xu6.dtsi"
#include "zynqmp_enclustra_mercury_st1.dtsi"
